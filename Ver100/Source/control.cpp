//----------------------------------------------------------------------------

//Модуль общего управления

//----------------------------------------------------------------------------

#include "control.hpp"
#include "dac.hpp"

//----------------------------------------------------------------------------
//---------------------------- Класс TControl: -------------------------------
//----------------------------------------------------------------------------

//--------------------- Начальная инициализация шкалы: -----------------------

int16_t TControl::dBTable[SEGS] =
{    0,   56,   70,  89,   112,  141,  177,  223,  281,  354,
   446,  562,  707,  891, 1122, 1258, 1412, 1584, 1778, 1883,
  1995, 2113, 2238, 2304, 2371, 2440, 2511, 2585, 2660, 2738,
  2818, 2900, 2985, 3072, 3162, 3254, 3349, 3447, 3548, 3758,
  3981, 4216, 4466, 5011, 5623, 6309, 7079, 7943, 8912, 10000
};

//----------------------------- Конструктор: ---------------------------------

TControl::TControl(void)
{
  //Dac1.Init();
  //Dac2.Init();
  Eeprom = new TEeprom();
  Display = new TDisplay();
  ProcessL = new TProcess(CHANL);
  ProcessR = new TProcess(CHANR);

  //initial check:
  Display->BarL(50);
  Display->BarR(50);
  Display->Scale(1);
  //Display->Leds(TRALL);
  Display->Update();
  TSysTimer::Delay_ms(200);

  EERead();                      //чтение EEPROM
  UpdL = 0;
  UpdR = 0;
  Upd = 0;

  //fall-back:
  //Display->Leds(TRNON);
  for(uint8_t i = SEGS; i > 0; i--)
  {
    Display->BarL(i);
    Display->BarR(i);
    Display->Update();
    TSysTimer::Delay_ms(20);
  }
}

//------------------------ Выполнение управления: ----------------------------

void TControl::Execute(void)
{
  //проверка готовности данных канала L:
  if(ProcessL->Execute()) UpdL = 1;
  //проверка готовности данных канала R:
  if(ProcessR->Execute()) UpdR = 1;
  //если оба канала готовы, вывод:
  if(UpdL && UpdR)
  {
    BarL = ProcessL->GetBar();
    BarR = ProcessR->GetBar();
    PeakL = ProcessL->GetPeak();
    PeakR = ProcessR->GetPeak();
    //TODO: статистика
    uint8_t PeakSegL = 0;
    uint8_t PeakSegR = 0;
    //заполнение столбиков:
    for(uint8_t i = 0; i < SEGS; i++)
    {
      uint16_t dB = dBTable[i];
      Display->SegL(i, BarL >= dB);
      Display->SegR(i, BarR >= dB);
      if(PeakL >= dB) PeakSegL = i;
      if(PeakR >= dB) PeakSegR = i;
    }
    //добавление точек:
    Display->SegL(PeakSegL, 1);
    Display->SegR(PeakSegR, 1);
    //обновление дисплея:
    Display->Update();
    //сброс флагов готовности:
    UpdL = 0;
    UpdR = 0;
    Upd = 1;
  }

//TODO: Сервис переключения пресетов:

}

//----------------------------------------------------------------------------
//------------------------- Реализация сервисов: -----------------------------
//----------------------------------------------------------------------------

//TODO: Сервис переключения пресетов:

//----------------------------------------------------------------------------
//------------------------- Интерфейсные методы: -----------------------------
//----------------------------------------------------------------------------

//-------------------------- Загрузка таблицы: -------------------------------

void TControl::SetTab(uint8_t n, int16_t v)
{
  if(n < SEGS) dBTable[n] = v;
}

//--------------------------- Чтение таблицы: --------------------------------

int16_t TControl::GetTab(uint8_t n)
{
  return(dBTable[n]);
}

//--------------------- Чтение параметров из EEPROM: -------------------------

void TControl::EERead(void)
{
  TProcess::EERead();
  for(uint8_t i = 0; i < SEGS; i++)
    dBTable[i] = Eeprom->Read(EE_DB_TAB + i, dBTable[i]);
}

//------------------- Сохранение параметров в EEPROM: ------------------------

void TControl::EESave(void)
{
  TProcess::EESave();
  for(uint8_t i = 0; i < SEGS; i++)
    Eeprom->Update(EE_DB_TAB + i, dBTable[i]);
}

//----------------------------------------------------------------------------
//----------------------------------------------------------------------------
//----------------------------------------------------------------------------
